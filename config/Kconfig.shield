## config/Kconfig.shield
```kconfig
 #
 # Copyright (c) 2020 The ZMK Contributors
 #
 # SPDX-License-Identifier: MIT
 #

config SHIELD_EEK_FLIP
    def_bool $(shields_list_contains,eek_flip)
```

## config/boards/shields/Kconfig.defconfig
```kconfig
# Copyright (c) 2020 The ZMK Contributors
# SPDX-License-Identifier: MIT

if SHIELD_EEK_FLIP

config ZMK_KEYBOARD_NAME
    default "eek!"

endif
```
